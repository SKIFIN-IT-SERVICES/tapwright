VERSION ""

NS_ :

BS_:

BU_: TestECU TestTool

BO_ 100 EngineData: 8 TestECU
 SG_ EngineSpeed : 0|16@1+ (0.25,0) [0|16383.75] "rpm" TestTool
 SG_ EngineTemp : 16|8@1+ (1,-40) [-40|215] "degC" TestTool

BO_ 2147483848 ExtendedMsg: 4 TestECU
 SG_ ExtSignal : 0|32@1+ (1,0) [0|4294967295] "" TestTool

BO_ 300 MuxMessage: 8 TestECU
 SG_ MuxSelector M : 0|8@1+ (1,0) [0|255] "" TestTool
 SG_ MuxedSignalA m0 : 8|16@1+ (1,0) [0|65535] "" TestTool
 SG_ MuxedSignalB m1 : 8|16@1+ (0.1,0) [0|6553.5] "" TestTool

CM_ BO_ 100 "Periodic engine data. Exercises multi-signal scaling, incl. a negative offset (EngineTemp).";
CM_ BO_ 2147483848 "Exercises a 29-bit extended arbitration ID.";
CM_ BO_ 300 "Exercises a 2-bit-selector-equivalent multiplexed message.";
