AUTOSAR XML (schema 4-2-2)
package /Cluster
  can cluster PowertrainCAN
    can physical channel PowertrainCAN_Channel
      frame VehicleStatus: id 0x300, frame-length=8, addressing-mode=STANDARD
        pdu VehicleStatus_Pdu: length=8
          signal Speed: start 0, 8 bit, little-endian, system signal Speed_Signal, compu {phys=raw*0.5-40; unit km/h}, range raw 0..255
          signal Odometer: start 8, 16 bit, little-endian, system signal Odometer_Signal, compu {phys=raw; unit km}, range raw 0..65535
      frame ExtendedDiag: id 0x18DAF100, frame-length=8, can-addressing-mode=EXTENDED
        pdu ExtendedDiag_Pdu: length=8
          signal DiagState: start 0, 8 bit, little-endian, system signal DiagState_Signal, compu {phys=raw}, range raw 0..255
package /Units
  unit KmPerHour: display-name=km/h
  unit Km: display-name=km
